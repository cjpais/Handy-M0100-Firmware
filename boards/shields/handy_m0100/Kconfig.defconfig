## boards/shields/handy_m0100/Kconfig.defconfig
```kconfig
if SHIELD_HANDY_M0100

# Name must be less than 16 characters long!
config ZMK_KEYBOARD_NAME
    default "Handy M0100"

endif
```

## boards/shields/handy_m0100/Kconfig.shield
```kconfig
# No whitespace after the comma or in your keyboard name!
config SHIELD_HANDY_M0100
    def_bool $(shields_list_contains,handy_m0100)
```

## boards/shields/retro/Kconfig.defconfig
```kconfig
if SHIELD_RETRO

# Name must be less than 16 characters long!
config ZMK_KEYBOARD_NAME
    default "Retro"

endif
```

## boards/shields/retro_one/Kconfig.defconfig
```kconfig
if SHIELD_RETRO_ONE

# Name must be less than 16 characters long!
config ZMK_KEYBOARD_NAME
    default "Retro One"

endif
```

## boards/shields/retro_one/Kconfig.shield
```kconfig
# No whitespace after the comma or in your keyboard name!
config SHIELD_RETRO_ONE
    def_bool $(shields_list_contains,retro_one)
```
