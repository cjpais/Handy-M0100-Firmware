#include <behaviors.dtsi>
#include <dt-bindings/zmk/keys.h>

&mt {
    tapping-term-ms = <20>;
};

/ {

    keymap {
        compatible = "zmk,keymap";

        default_layer { // Layer 0
            bindings = <
                &mt RC(RMETA) A
            >;
        };
    };
 };